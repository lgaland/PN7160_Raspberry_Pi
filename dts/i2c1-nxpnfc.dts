/dts-v1/;
/plugin/;

/{
    compatible = "brcm,bcm2711";

    fragment@0 {
        target = <&i2c1>;
        __overlay__ {
            status = "okay";

            nxpnfc@28 {
                compatible = "nxp,nxpnfc";
                reg = <0x28>;

                nxp,nxpnfc-irq = <&gpio 23 0>;
                nxp,nxpnfc-ven = <&gpio 24 1>;
                nxp,nxpnfc-fw-dwnld = <&gpio 25 1>;
            };
        };
    };
};

